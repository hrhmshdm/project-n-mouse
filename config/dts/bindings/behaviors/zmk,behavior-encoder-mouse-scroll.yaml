## config/dts/bindings/behaviors/zmk,behavior-encoder-mouse-scroll.yaml
```yaml
description: Encoder Mouse Scroll Behavior (One-shot)

compatible: "zmk,behavior-encoder-mouse-scroll"

properties:
  "#sensor-binding-cells":
    type: int
    required: true
    const: 2

sensor-binding-cells:
  - param1
  - param2
```

## config/west.yml
```yaml
manifest:
  remotes:
    - name: zmkfirmware
      url-base: https://github.com/zmkfirmware
    - name: hrhmshdm
      url-base: https://github.com/hrhmshdm
    - name: caksoylar
      url-base: https://github.com/caksoylar
  projects:
    - name: zmk
      remote: zmkfirmware
      revision: v0.3
      import: app/west.yml
    - name: zmk-paw3395-driver
      remote: hrhmshdm
      revision: bffa61761dc1fb87d8bc04133c55a10bc899a359
    - name: zmk-rgbled-widget
      remote: caksoylar
      revision: main
  self:
    path: config
```
